## bbq10kbd_module/zephyr/Kconfig
```kconfig
# SPDX-License-Identifier: Apache-2.0

config BBQ10KBD_DRIVER
	bool "BBQ10KBD i2c keyboard driver"
	depends on I2C
	help
	  Enable driver for BBQ10KBD I2C-based keyboard.
```

## boards/arm/bb_kb/Kconfig.board
```kconfig
# nRF52840 DK NRF52840 board configuration

# Copyright (c) 2016 Nordic Semiconductor ASA
# SPDX-License-Identifier: Apache-2.0

config BOARD_BB_KB
	bool "bb_kb"
	depends on SOC_NRF52840_QIAA
```

## boards/arm/bb_kb/Kconfig.defconfig
```kconfig
# nRF52840 DK NRF52840 board configuration

# Copyright (c) 2016 Nordic Semiconductor ASA
# SPDX-License-Identifier: Apache-2.0

if BOARD_BB_KB

config BOARD
	default "bb_kb"

if USB

config USB_NRFX
	default y

config USB_DEVICE_STACK
	default y

endif # USB

config BT_CTLR
	default BT

endif # BOARD_BB_KB
```

## drivers/bbq10kbd/Kconfig
```kconfig
menuconfig BBQ10KBD
	bool "BBQ10KBD keyboard"
	depends on I2C
	help
	  Enable driver for BBQ10KBD I2C-based keyboard.
```
